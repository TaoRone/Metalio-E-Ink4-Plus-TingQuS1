## main/Kconfig.projbuild
```kconfig
menu "Metalio E-Ink4-Plus"

choice BOARD_TYPE
    prompt "Board Type"
    default BOARD_TYPE_METALIO_E_INK4_PLUS
    help
        S31 并行墨水屏 + 百问 AI。

    config BOARD_TYPE_METALIO_E_INK4_PLUS
        bool "Metalio E-Ink4-Plus (4.7 parallel)"
        depends on IDF_TARGET_ESP32S31

    config BOARD_TYPE_METALIO_E_INK4_PLUS_GLOBAL
        bool "Metalio E-Ink4-Plus Global (4.7 parallel)"
        depends on IDF_TARGET_ESP32S31
endchoice

choice WAKE_WORD_TYPE
    prompt "Wake word implementation"
    default WAKE_WORD_DISABLED
    help
        百问为 PTT；默认关闭唤醒词。

    config WAKE_WORD_DISABLED
        bool "Disabled"
    config USE_ESP_WAKE_WORD
        bool "ESP Wake Word"
    config USE_AFE_WAKE_WORD
        bool "AFE Wake Word"
        depends on SPIRAM
    config USE_CUSTOM_WAKE_WORD
        bool "Custom Wake Word"
endchoice

config USE_AUDIO_PROCESSOR
    bool "Enable audio processor (AFE)"
    default n
    depends on SPIRAM
    help
        VAD/AEC 处理；S31 无 esp-sr 时关，走 no_audio_processor。

config USE_DEVICE_AEC
    bool "Device AEC"
    default n
    depends on USE_AUDIO_PROCESSOR

config USE_SERVER_AEC
    bool "Server AEC"
    default n
    depends on USE_AUDIO_PROCESSOR

config METALIO_TOUCH_UPGRADE_ON_BOOT
    bool "Upgrade LT0470GF0430M FT6336U touch firmware to V03 on boot"
    default n
    help
        Only for the LT0470GF0430M 684x1216 FT6336U panel. Runs before
        touch/display tasks start, using the embedded supplier app image.
        Checks chip and bootloader IDs, packet status, XOR and final version.
        Skips V03 and newer versions. Keep power connected throughout the
        update. Disable after a successful update; not for other touch panels.

config USE_AUDIO_DEBUGGER
    bool "Audio debugger"
    default n

config TINGQU_HIDE_TASK_APP
    bool "TingQuS1: hide Daily Checklist app from home"
    default y
    help
        软裁剪：仅从首页/应用列表隐藏「每日清单」，代码完整保留，
        设为 n 即可回开。云端 endpoint 留空时该应用本就不可用。

config TINGQU_HIDE_ASSISTANT_APP
    bool "TingQuS1: hide Baiwen AI app from home"
    default y
    help
        软裁剪：仅从首页/应用列表隐藏「百问 AI」，代码完整保留，
        设为 n 即可回开。云端 endpoint 留空时语音助手不可用。

endmenu
```
